/*
 * Copyright (c) 2017, Sustainable Communication Networks, Universität Bremen.
 * All rights reserved.
 *
 * Redistribution and use in source and binary forms, with or without
 * modification, are permitted provided that the following conditions
 * are met:
 * 1. Redistributions of source code must retain the above copyright
 *    notice, this list of conditions and the following disclaimer.
 * 2. Redistributions in binary form must reproduce the above copyright
 *    notice, this list of conditions and the following disclaimer in the
 *    documentation and/or other materials provided with the distribution.
 * 3. Neither the name of the Institute nor the names of its contributors
 *    may be used to endorse or promote products derived from this software
 *    without specific prior written permission.
 *
 * THIS SOFTWARE IS PROVIDED BY THE INSTITUTE AND CONTRIBUTORS ``AS IS'' AND
 * ANY EXPRESS OR IMPLIED WARRANTIES, INCLUDING, BUT NOT LIMITED TO, THE
 * IMPLIED WARRANTIES OF MERCHANTABILITY AND FITNESS FOR A PARTICULAR PURPOSE
 * ARE DISCLAIMED.  IN NO EVENT SHALL THE INSTITUTE OR CONTRIBUTORS BE LIABLE
 * FOR ANY DIRECT, INDIRECT, INCIDENTAL, SPECIAL, EXEMPLARY, OR CONSEQUENTIAL
 * DAMAGES (INCLUDING, BUT NOT LIMITED TO, PROCUREMENT OF SUBSTITUTE GOODS
 * OR SERVICES; LOSS OF USE, DATA, OR PROFITS; OR BUSINESS INTERRUPTION)
 * HOWEVER CAUSED AND ON ANY THEORY OF LIABILITY, WHETHER IN CONTRACT, STRICT
 * LIABILITY, OR TORT (INCLUDING NEGLIGENCE OR OTHERWISE) ARISING IN ANY WAY
 * OUT OF THE USE OF THIS SOFTWARE, EVEN IF ADVISED OF THE POSSIBILITY OF
 * SUCH DAMAGE.
 *
 * This file is part of the Contiki operating system.
 *
 */

/**
 * \file
 *         Main run-file for RFID Tag UID reader implementation on Z1
 * \author
 *         Mine Cetinkaya <mine.cetinkaya@gmail.com>
 * 	   Jens Dede <jd@comnets.uni-bremen.de>
 */

#include <stdio.h>
#include <inttypes.h>
#include <string.h>
#include "contiki.h"
#include "dev/spi.h"
#include "platform/z1/platform-conf.h"
#include "dev/mfrc522.c"

/*------------------------------------------------------------------*/
PROCESS(READ_PICC_UID, "Read PICC UID");
AUTOSTART_PROCESSES(&READ_PICC_UID);
/*------------------------------------------------------------------*/
PROCESS_THREAD(READ_PICC_UID, ev, data)
{
PROCESS_BEGIN();


while(1) {
	
	//initiate the MFRC522 Reader chip
	MFRC522_Init();
	printf("Chip initiation completed\n");
	
	//Printout the software version of the Reader
	uchar received=Read_MFRC522(VersionReg);
	printf("MFRC522 Version(0x): %x\n",received);

	uchar status, checksum1, str[MAX_LEN];
	//Tag communication request
	status = MFRC522_Request(PICC_REQALL, str);

	//if Tag status is OK, inform the user
  	if(status == MI_OK) {
    	printf("~~~ Card detected!\t%x , %x\r\n", str[0], str[1]);
  	}
	
	// Check for Anti-collision, if status is OK, then return the card serial number == 4 bytes
 	status = MFRC522_Anticoll(str);
	
 	if(status == MI_OK) {
  	checksum1 = str[0] ^ str[1] ^ str[2] ^ str[3];

        printf("~~~ The card's number is: %x %x %x %x %x\t checksum: %x\r\n", str[0], str[1], str[2], str[3], str[4], checksum1);
	
  	}

	return(0);
	PROCESS_YIELD();	
       
}

PROCESS_END();

}

