/*
 * Copyright (c) 2015, Benoît Thébaudeau <benoit.thebaudeau.dev@gmail.com>
 * All rights reserved.
 *
 * Redistribution and use in source and binary forms, with or without
 * modification, are permitted provided that the following conditions
 * are met:
 * 1. Redistributions of source code must retain the above copyright
 *    notice, this list of conditions and the following disclaimer.
 * 2. Redistributions in binary form must reproduce the above copyright
 *    notice, this list of conditions and the following disclaimer in the
 *    documentation and/or other materials provided with the distribution.
 *
 * 3. Neither the name of the copyright holder nor the names of its
 *    contributors may be used to endorse or promote products derived
 *    from this software without specific prior written permission.
 *
 * THIS SOFTWARE IS PROVIDED BY THE COPYRIGHT HOLDERS AND CONTRIBUTORS
 * ``AS IS'' AND ANY EXPRESS OR IMPLIED WARRANTIES, INCLUDING, BUT NOT
 * LIMITED TO, THE IMPLIED WARRANTIES OF MERCHANTABILITY AND FITNESS
 * FOR A PARTICULAR PURPOSE ARE DISCLAIMED.  IN NO EVENT SHALL THE
 * COPYRIGHT HOLDER OR CONTRIBUTORS BE LIABLE FOR ANY DIRECT, INDIRECT,
 * INCIDENTAL, SPECIAL, EXEMPLARY, OR CONSEQUENTIAL DAMAGES
 * (INCLUDING, BUT NOT LIMITED TO, PROCUREMENT OF SUBSTITUTE GOODS OR
 * SERVICES; LOSS OF USE, DATA, OR PROFITS; OR BUSINESS INTERRUPTION)
 * HOWEVER CAUSED AND ON ANY THEORY OF LIABILITY, WHETHER IN CONTRACT,
 * STRICT LIABILITY, OR TORT (INCLUDING NEGLIGENCE OR OTHERWISE)
 * ARISING IN ANY WAY OUT OF THE USE OF THIS SOFTWARE, EVEN IF ADVISED
 * OF THE POSSIBILITY OF SUCH DAMAGE.
 */
/**
 * \addtogroup cc2538-examples
 * @{
 *
 * \defgroup cc2538-gcm-test cc2538dk AES-GCM Test Project
 *
 *   AES-GCM access example for CC2538 on SmartRF06EB.
 *
 *   This example shows how AES-GCM should be used. The example also verifies
 *   the AES-GCM functionality.
 *
 * @{
 *
 * \file
 *     Example demonstrating AES-GCM on the cc2538dk platform
 */
#include "contiki.h"
#include "sys/rtimer.h"
#include "dev/rom-util.h"
#include "dev/gcm.h"

#include <stdbool.h>
#include <stdio.h>
#include <stdint.h>
/*---------------------------------------------------------------------------*/
#define ADATA_MAX_LEN   90
#define MDATA_MAX_LEN   51
/*---------------------------------------------------------------------------*/
PROCESS(gcm_test_process, "gcm test process");
AUTOSTART_PROCESSES(&gcm_test_process);
/*---------------------------------------------------------------------------*/
PROCESS_THREAD(gcm_test_process, ev, data)
{
  static const char *const str_res[] = {
    "success",
    "invalid param",
    "NULL error",
    "resource in use",
    "DMA bus error",
    "keystore read error",
    "keystore write error",
    "authentication failed"
  };
  static const uint8_t keys128[][128 / 8] = {
    { 0x2f, 0xb4, 0x5e, 0x5b, 0x8f, 0x99, 0x3a, 0x2b,
      0xfe, 0xbc, 0x4b, 0x15, 0xb5, 0x33, 0xe0, 0xb4 },
    { 0xc9, 0x39, 0xcc, 0x13, 0x39, 0x7c, 0x1d, 0x37,
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      0x40, 0x9a, 0x39, 0xa4, 0x0d, 0xf8, 0xc7, 0xee }
  };
  static const uint8_t keys192[][192 / 8] = {
    { 0x5d, 0xaa, 0x89, 0x10, 0xd9, 0xdc, 0x50, 0x68,
      0xf2, 0xf5, 0x5c, 0x16, 0x39, 0x86, 0xd0, 0x71,
      0x45, 0x23, 0x44, 0xa5, 0xea, 0xc5, 0xa8, 0x05 },
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    { 0x9b, 0x37, 0xbf, 0x6b, 0x0a, 0xa8, 0xff, 0x75,
      0xf3, 0x04, 0xed, 0xa7, 0xa9, 0x51, 0x2d, 0xba,
      0x7c, 0x9f, 0x80, 0xd6, 0x1e, 0x29, 0x5e, 0x85 }
  };
  static const uint8_t keys256[][256 / 8] = {
    { 0xdc, 0x77, 0x6f, 0x01, 0x56, 0xc1, 0x5d, 0x03,
      0x26, 0x23, 0x85, 0x4b, 0x62, 0x5c, 0x61, 0x86,
      0x8e, 0x5d, 0xb8, 0x4b, 0x7b, 0x6f, 0x9f, 0xbd,
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      0x45, 0x1f, 0x6d, 0x0f, 0xc2, 0xa8, 0x50, 0x7a }
  };
  static const struct {
    const void *keys;
    uint8_t key_size;
    uint8_t count;
  } keys[] = {
    { keys128, AES_KEY_STORE_SIZE_KEY_SIZE_128,
      sizeof(keys128) / sizeof(keys128[0]) },
    { keys192, AES_KEY_STORE_SIZE_KEY_SIZE_192,
      sizeof(keys192) / sizeof(keys192[0]) },
    { keys256, AES_KEY_STORE_SIZE_KEY_SIZE_256,
      sizeof(keys256) / sizeof(keys256[0]) }
  };
  static const struct {
    bool encrypt;
    uint8_t key_size_index;
    uint8_t key_area;
    uint8_t iv[GCM_IV_LEN];
    uint8_t adata[ADATA_MAX_LEN];
    uint16_t adata_len;
    uint8_t mdata[MDATA_MAX_LEN];
    uint16_t mdata_len;
    uint8_t tag[GCM_TAG_LEN];
    uint8_t expected[MDATA_MAX_LEN];
  } vectors[] = {
    {
      true, /* encrypt */
      0, /* key_size_index */
      0, /* key_area */
      { 0x5b, 0x05, 0x75, 0x5f, 0x98, 0x4d, 0x2b, 0x90,
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        0x32, 0x47, 0x39, 0x41 }, /* adata */
      20, /* adata_len */
      {}, /* mdata */
      0, /* mdata_len */
      { 0xc7, 0x5b, 0x78, 0x32, 0xb2, 0xa2, 0xd9, 0xbd,
        0x82, 0x74, 0x12, 0xb6, 0xef, 0x57, 0x69, 0xdb }, /* tag */
      {} /* expected */
    }, {
      true, /* encrypt */
      0, /* key_size_index */
      1, /* key_area */
      { 0xb3, 0xd8, 0xcc, 0x01, 0x7c, 0xbb, 0x89, 0xb3,
        0x9e, 0x0f, 0x67, 0xe2 }, /* iv */
      { 0x24, 0x82, 0x56, 0x02, 0xbd, 0x12, 0xa9, 0x84,
        0xe0, 0x09, 0x2d, 0x3e, 0x44, 0x8e, 0xda, 0x5f }, /* adata */
      16, /* adata_len */
      { 0xc3, 0xb3, 0xc4, 0x1f, 0x11, 0x3a, 0x31, 0xb7,
        0x3d, 0x9a, 0x5c, 0xd4, 0x32, 0x10, 0x30, 0x69 }, /* mdata */
      16, /* mdata_len */
      { 0x00, 0x32, 0xa1, 0xdc, 0x85, 0xf1, 0xc9, 0x78,
        0x69, 0x25, 0xa2, 0xe7, 0x1d, 0x82, 0x72, 0xdd }, /* tag */
      { 0x93, 0xfe, 0x7d, 0x9e, 0x9b, 0xfd, 0x10, 0x34,
        0x8a, 0x56, 0x06, 0xe5, 0xca, 0xfa, 0x73, 0x54 } /* expected */
    }, {
      true, /* encrypt */
      0, /* key_size_index */
      2, /* key_area */
      { 0x3b, 0xb9, 0xeb, 0x77, 0x24, 0xcb, 0xe1, 0x94,
        0x3d, 0x43, 0xde, 0x21 }, /* iv */
      { 0x26, 0x62, 0xd8, 0x95, 0x03, 0x5b, 0x65, 0x19,
        0xf3, 0x51, 0x0e, 0xae, 0x0f, 0xaa, 0x39, 0x00,
        0xad, 0x23, 0xcf, 0xdf }, /* adata */
      20, /* adata_len */
      { 0xfd, 0x33, 0x1c, 0xa8, 0x64, 0x60, 0x91, 0xc2,
        0x9f, 0x21, 0xe5, 0xf0, 0xa1 }, /* mdata */
      13, /* mdata_len */
      { 0xd2, 0x4c, 0x3e, 0x9c, 0x1c, 0x73, 0xc0, 0xaf,
        0x10, 0x97, 0xe2, 0x60, 0x61, 0xc8, 0x57, 0xde }, /* tag */
      { 0x59, 0xfe, 0x29, 0xb0, 0x7b, 0x0d, 0xe8, 0xd8,
        0x69, 0xef, 0xbb, 0xd9, 0xb4 } /* expected */
    }, {
      true, /* encrypt */
      0, /* key_size_index */
      3, /* key_area */
      { 0x07, 0xa9, 0xa9, 0x5e, 0xa3, 0x82, 0x1e, 0x9c,
        0x13, 0xc6, 0x32, 0x51 }, /* iv */
      {}, /* adata */
      0, /* adata_len */
      { 0xf5, 0x4b, 0xc3, 0x50, 0x1f, 0xed, 0x4f, 0x6f,
        0x6d, 0xfb, 0x5e, 0xa8, 0x01, 0x06, 0xdf, 0x0b,
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        0xd9, 0xca, 0x92, 0x97, 0xcd, 0x2c, 0x6a, 0x01 } /* expected */
    }, {
      false, /* encrypt */
      0, /* key_size_index */
      4, /* key_area */
      { 0x58, 0x4c, 0x29, 0x1f, 0xf1, 0xaa, 0x38, 0x8a,
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        0xad, 0xe0, 0x20, 0x26, 0x12, 0x23, 0xdf, 0xce }, /* adata */
      48, /* adata_len */
      {}, /* mdata */
      0, /* mdata_len */
      { 0x9a, 0xc7, 0xeb, 0x2d, 0x76, 0x2f, 0xac, 0xae,
        0x06, 0x08, 0x6c, 0x95, 0x79, 0x59, 0x88, 0x0e }, /* tag */
      {} /* expected */
    }, {
      false, /* encrypt */
      0, /* key_size_index */
      5, /* key_area */
      { 0x8e, 0x69, 0xfa, 0x64, 0xe8, 0x71, 0xd0, 0xe9,
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        0xe8, 0x18, 0xda, 0x71, 0xfc, 0x69, 0xc9, 0x81 } /* expected */
    }, {
      false, /* encrypt */
      0, /* key_size_index */
      6, /* key_area */
      { 0x3f, 0x39, 0x83, 0xdc, 0x63, 0x98, 0x6e, 0x33,
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        0xe3, 0x8e, 0x95, 0x01, 0xe7 } /* expected */
    }, {
      false, /* encrypt */
      0, /* key_size_index */
      7, /* key_area */
      { 0x8a, 0xd7, 0x33, 0xa4, 0xa9, 0xb8, 0x33, 0x06,
        0x90, 0x23, 0x8c, 0x42 }, /* iv */
      {}, /* adata */
      0, /* adata_len */
      { 0xbb, 0xb5, 0xb6, 0x72, 0xa4, 0x79, 0xaf, 0xca,
        0x2b, 0x11, 0xad, 0xb0, 0xa4, 0xc7, 0x62, 0xb6,
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        0x00, 0xc2, 0x79 } /* expected */
    }, {
      true, /* encrypt */
      1, /* key_size_index */
      0, /* key_area */
      { 0x8f, 0x88, 0xd7, 0x0e, 0x25, 0x0d, 0xbf, 0x12,
        0x82, 0x41, 0x3f, 0xd7 }, /* iv */
      { 0x3b, 0x3b, 0xbb, 0x2c, 0xcd, 0x76, 0x23, 0x6f,
        0x07, 0x4e, 0xec, 0xc1, 0x9f, 0x34, 0x10, 0x57 }, /* adata */
      16, /* adata_len */
      { 0x42, 0x35, 0xe4, 0x2f, 0x32, 0xcf, 0xf4, 0x4a,
        0x50, 0x7d, 0xd8, 0xa3, 0x66 }, /* mdata */
      13, /* mdata_len */
      { 0x4c, 0xdd, 0xdb, 0x4a, 0x95, 0x46, 0xa8, 0xd7,
        0x3a, 0xfc, 0x9f, 0x5e, 0x46, 0xa9, 0x26, 0xf3 }, /* tag */
      { 0xe9, 0x2d, 0xf9, 0xd2, 0xfd, 0x43, 0x6e, 0xd2,
        0x54, 0xfa, 0x92, 0x78, 0x9c } /* expected */
    }, {
      true, /* encrypt */
      1, /* key_size_index */
      2, /* key_area */
      { 0xe9, 0x5e, 0xbb, 0x1e, 0x8d, 0x31, 0xd1, 0xac,
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        0x22, 0xc7, 0xb5, 0xbe, 0x19, 0x99, 0x68, 0x37 } /* expected */
    }, {
      false, /* encrypt */
      1, /* key_size_index */
      4, /* key_area */
      { 0x78, 0xec, 0x38, 0x73, 0xbd, 0x88, 0x46, 0xac,
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        0x4e, 0x2f, 0x24, 0xb1, 0xee } /* expected */
    }, {
      false, /* encrypt */
      1, /* key_size_index */
      6, /* key_area */
      { 0x2e, 0x8e, 0xf3, 0x3d, 0x26, 0x5d, 0x48, 0x19,
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        0x54, 0xdc, 0x75 } /* expected */
    }, {
      true, /* encrypt */
      2, /* key_size_index */
      0, /* key_area */
      { 0x67, 0x13, 0x09, 0x51, 0xc4, 0xa5, 0x7f, 0x6a,
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        0x2a, 0x88, 0x41, 0xff, 0x0a, 0xb9, 0xd6, 0x0d } /* expected */
    }, {
      true, /* encrypt */
      2, /* key_size_index */
      2, /* key_area */
      { 0xb0, 0x8a, 0x5e, 0xa1, 0x92, 0x74, 0x99, 0xc6,
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        0x78, 0xfd, 0x3f } /* expected */
    }, {
      false, /* encrypt */
      2, /* key_size_index */
      4, /* key_area */
      { 0x72, 0x48, 0xa5, 0xed, 0x48, 0xf4, 0xf1, 0xb4,
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        0x22, 0x31, 0x5f, 0x41, 0x81, 0x77, 0x17, 0xa7 } /* expected */
    }, {
      false, /* encrypt */
      2, /* key_size_index */
      6, /* key_area */
      { 0xea, 0x6f, 0x5b, 0x39, 0x1e, 0x44, 0xb7, 0x51,
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        0xf0, 0x78, 0x34 } /* expected */
    }
  };
  static uint8_t adata[ADATA_MAX_LEN];
  static uint8_t mdata[MDATA_MAX_LEN];
  static uint8_t tag[GCM_TAG_LEN];
  static int i;
  static uint8_t key_size_index = -1, ret;
  static rtimer_clock_t time, time2, total_time;

  PROCESS_BEGIN();

  puts("-----------------------------------------\n"
       "Initializing cryptoprocessor...");
  crypto_init();

  for(i = 0; i < sizeof(vectors) / sizeof(vectors[0]); i++) {
    if(key_size_index != vectors[i].key_size_index) {
      key_size_index = vectors[i].key_size_index;
      printf("-----------------------------------------\n"
             "Filling %d-bit key store...\n", 128 + (key_size_index << 6));
      time = RTIMER_NOW();
      ret = aes_load_keys(keys[key_size_index].keys,
              keys[key_size_index].key_size, keys[key_size_index].count, 0);
      time = RTIMER_NOW() - time;
      printf("aes_load_keys(): %s, %lu us\n", str_res[ret],
             (uint32_t)((uint64_t)time * 1000000 / RTIMER_SECOND));
      PROCESS_PAUSE();
      if(ret != CRYPTO_SUCCESS) {
        break;
      }
    }

    printf("-----------------------------------------\n"
           "Test vector #%d: %s\n"
           "key_area=%d adata_len=%d mdata_len=%d\n",
           i, vectors[i].encrypt ? "encrypt" : "decrypt",
           vectors[i].key_area, vectors[i].adata_len, vectors[i].mdata_len);

    /* adata and mdata have to be in SRAM. */
    rom_util_memcpy(adata, vectors[i].adata, vectors[i].adata_len);
    rom_util_memcpy(mdata, vectors[i].mdata, vectors[i].mdata_len);

    time = RTIMER_NOW();
    if(vectors[i].encrypt) {
      ret = gcm_auth_encrypt_start(vectors[i].key_area, vectors[i].iv, adata,
                                   vectors[i].adata_len, mdata,
                                   vectors[i].mdata_len, mdata,
                                   &gcm_test_process);
      time2 = RTIMER_NOW();
      time = time2 - time;
      total_time = time;
      if(ret == CRYPTO_SUCCESS) {
        PROCESS_WAIT_EVENT_UNTIL(gcm_auth_encrypt_check_status());
        time2 = RTIMER_NOW() - time2;
        total_time += time2;
      }
      printf("gcm_auth_encrypt_start(): %s, %lu us\n", str_res[ret],
             (uint32_t)((uint64_t)time * 1000000 / RTIMER_SECOND));
      if(ret != CRYPTO_SUCCESS) {
        PROCESS_PAUSE();
        continue;
      }
      printf("gcm_auth_encrypt_check_status() wait: %lu us\n",
             (uint32_t)((uint64_t)time2 * 1000000 / RTIMER_SECOND));

      time = RTIMER_NOW();
      ret = gcm_auth_encrypt_get_result(tag);
      time = RTIMER_NOW() - time;
      total_time += time;
      printf("gcm_auth_encrypt_get_result(): %s, %lu us\n", str_res[ret],
             (uint32_t)((uint64_t)time * 1000000 / RTIMER_SECOND));
      PROCESS_PAUSE();
      if(ret != CRYPTO_SUCCESS) {
        continue;
      }

      if(rom_util_memcmp(mdata, vectors[i].expected, vectors[i].mdata_len)) {
        puts("Encrypted message does not match expected one");
      } else {
        puts("Encrypted message OK");
      }

      if(rom_util_memcmp(tag, vectors[i].tag, GCM_TAG_LEN)) {
        puts("Tag does not match expected one");
      } else {
        puts("Tag OK");
      }
    } else {
      ret = gcm_auth_decrypt_start(vectors[i].key_area, vectors[i].iv, adata,
                                   vectors[i].adata_len, mdata,
                                   vectors[i].mdata_len, mdata,
                                   &gcm_test_process);
      time2 = RTIMER_NOW();
      time = time2 - time;
      total_time = time;
      if(ret == CRYPTO_SUCCESS) {
        PROCESS_WAIT_EVENT_UNTIL(gcm_auth_decrypt_check_status());
        time2 = RTIMER_NOW() - time2;
        total_time += time2;
      }
      printf("gcm_auth_decrypt_start(): %s, %lu us\n", str_res[ret],
             (uint32_t)((uint64_t)time * 1000000 / RTIMER_SECOND));
      if(ret != CRYPTO_SUCCESS) {
        PROCESS_PAUSE();
        continue;
      }
      printf("gcm_auth_decrypt_check_status() wait: %lu us\n",
             (uint32_t)((uint64_t)time2 * 1000000 / RTIMER_SECOND));

      time = RTIMER_NOW();
      ret = gcm_auth_decrypt_get_result(vectors[i].tag, tag);
      time = RTIMER_NOW() - time;
      total_time += time;
      printf("gcm_auth_decrypt_get_result(): %s, %lu us\n", str_res[ret],
             (uint32_t)((uint64_t)time * 1000000 / RTIMER_SECOND));
      PROCESS_PAUSE();
      if(ret != CRYPTO_SUCCESS) {
        continue;
      }

      if(rom_util_memcmp(mdata, vectors[i].expected, vectors[i].mdata_len)) {
        puts("Decrypted message does not match expected one");
      } else {
        puts("Decrypted message OK");
      }
    }

    printf("Total duration: %lu us\n",
           (uint32_t)((uint64_t)total_time * 1000000 / RTIMER_SECOND));
  }

  puts("-----------------------------------------\n"
       "Disabling cryptoprocessor...");
  crypto_disable();

  puts("Done!");

  PROCESS_END();
}
/*---------------------------------------------------------------------------*/
/**
 * @}
 * @}
 */
