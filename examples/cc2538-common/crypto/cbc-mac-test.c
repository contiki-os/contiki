/*
 * Copyright (c) 2016, Benoît Thébaudeau <benoit.thebaudeau.dev@gmail.com>
 * All rights reserved.
 *
 * Redistribution and use in source and binary forms, with or without
 * modification, are permitted provided that the following conditions
 * are met:
 * 1. Redistributions of source code must retain the above copyright
 *    notice, this list of conditions and the following disclaimer.
 * 2. Redistributions in binary form must reproduce the above copyright
 *    notice, this list of conditions and the following disclaimer in the
 *    documentation and/or other materials provided with the distribution.
 *
 * 3. Neither the name of the copyright holder nor the names of its
 *    contributors may be used to endorse or promote products derived
 *    from this software without specific prior written permission.
 *
 * THIS SOFTWARE IS PROVIDED BY THE COPYRIGHT HOLDERS AND CONTRIBUTORS
 * ``AS IS'' AND ANY EXPRESS OR IMPLIED WARRANTIES, INCLUDING, BUT NOT
 * LIMITED TO, THE IMPLIED WARRANTIES OF MERCHANTABILITY AND FITNESS
 * FOR A PARTICULAR PURPOSE ARE DISCLAIMED.  IN NO EVENT SHALL THE
 * COPYRIGHT HOLDER OR CONTRIBUTORS BE LIABLE FOR ANY DIRECT, INDIRECT,
 * INCIDENTAL, SPECIAL, EXEMPLARY, OR CONSEQUENTIAL DAMAGES
 * (INCLUDING, BUT NOT LIMITED TO, PROCUREMENT OF SUBSTITUTE GOODS OR
 * SERVICES; LOSS OF USE, DATA, OR PROFITS; OR BUSINESS INTERRUPTION)
 * HOWEVER CAUSED AND ON ANY THEORY OF LIABILITY, WHETHER IN CONTRACT,
 * STRICT LIABILITY, OR TORT (INCLUDING NEGLIGENCE OR OTHERWISE)
 * ARISING IN ANY WAY OUT OF THE USE OF THIS SOFTWARE, EVEN IF ADVISED
 * OF THE POSSIBILITY OF SUCH DAMAGE.
 */
/**
 * \addtogroup cc2538-examples
 * @{
 *
 * \defgroup cc2538-cbc-mac-test cc2538 AES-CBC-MAC Test Project
 *
 *   AES-CBC-MAC access example for CC2538-based platforms
 *
 *   This example shows how AES-CBC-MAC should be used. The example also
 *   verifies the AES-CBC-MAC functionality.
 *
 * @{
 *
 * \file
 *     Example demonstrating AES-CBC-MAC
 */
#include "contiki.h"
#include "sys/rtimer.h"
#include "dev/rom-util.h"
#include "dev/cbc-mac.h"

#include <stdbool.h>
#include <stdio.h>
#include <stdint.h>
/*---------------------------------------------------------------------------*/
#define MDATA_MAX_LEN   160
/*---------------------------------------------------------------------------*/
PROCESS(cbc_mac_test_process, "cbc_mac test process");
AUTOSTART_PROCESSES(&cbc_mac_test_process);
/*---------------------------------------------------------------------------*/
PROCESS_THREAD(cbc_mac_test_process, ev, data)
{
  static const char *const str_res[] = {
    "success",
    "invalid param",
    "NULL error",
    "resource in use",
    "DMA bus error",
    "keystore read error",
    "keystore write error",
    "authentication failed"
  };
  static const uint8_t keys128[][128 / 8] = {
    { 0x1f, 0x8e, 0x49, 0x73, 0x95, 0x3f, 0x3f, 0xb0,
      0xbd, 0x6b, 0x16, 0x66, 0x2e, 0x9a, 0x3c, 0x17 },
    { 0xb7, 0xf3, 0xc9, 0x57, 0x6e, 0x12, 0xdd, 0x0d,
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      0x25, 0xbb, 0xe7, 0x87, 0x70, 0xca, 0x2f, 0x99 }
  };
  static const uint8_t keys192[][192 / 8] = {
    { 0xba, 0x75, 0xf4, 0xd1, 0xd9, 0xd7, 0xcf, 0x7f,
      0x55, 0x14, 0x45, 0xd5, 0x6c, 0xc1, 0xa8, 0xab,
      0x2a, 0x07, 0x8e, 0x15, 0xe0, 0x49, 0xdc, 0x2c },
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    { 0x50, 0x9b, 0xaf, 0x46, 0xfb, 0x9d, 0xe3, 0x42,
      0x81, 0xda, 0xfc, 0xc3, 0xdb, 0x79, 0x59, 0x3b,
      0xff, 0xa8, 0x42, 0x69, 0x04, 0x30, 0x26, 0x88 }
  };
  static const uint8_t keys256[][256 / 8] = {
    { 0x6e, 0xd7, 0x6d, 0x2d, 0x97, 0xc6, 0x9f, 0xd1,
      0x33, 0x95, 0x89, 0x52, 0x39, 0x31, 0xf2, 0xa6,
      0xcf, 0xf5, 0x54, 0xb1, 0x5f, 0x73, 0x8f, 0x21,
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      0x84, 0x19, 0x0e, 0x44, 0xd1, 0x4c, 0x69, 0x96 }
  };
  static const struct {
    const void *keys;
    uint8_t key_size;
    uint8_t count;
  } keys[] = {
    { keys128, AES_KEY_STORE_SIZE_KEY_SIZE_128,
      sizeof(keys128) / sizeof(keys128[0]) },
    { keys192, AES_KEY_STORE_SIZE_KEY_SIZE_192,
      sizeof(keys192) / sizeof(keys192[0]) },
    { keys256, AES_KEY_STORE_SIZE_KEY_SIZE_256,
      sizeof(keys256) / sizeof(keys256[0]) }
  };
  static const struct {
    uint8_t key_size_index;
    uint8_t key_area;
    uint8_t mdata[MDATA_MAX_LEN];
    uint16_t mdata_len;
    uint8_t mac[CBC_MAC_MAC_LEN];
  } vectors[] = {
    {
      0, /* key_size_index */
      0, /* key_area */
      { 0x45, 0xcf, 0x12, 0x96, 0x4f, 0xc8, 0x24, 0xab,
        0x76, 0x61, 0x6a, 0xe2, 0xf4, 0xbf, 0x08, 0x22 }, /* mdata */
      16, /* mdata_len */
      { 0x97, 0x67, 0x0c, 0x83, 0x99, 0x24, 0xa4, 0xc6,
        0x15, 0xb0, 0xf6, 0x14, 0xae, 0x75, 0xa8, 0x69 } /* mac */
    }, {
      0, /* key_size_index */
      1, /* key_area */
      { 0x9a, 0xc1, 0x99, 0x54, 0xce, 0x13, 0x19, 0xb3,
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        0x56, 0x36, 0x36, 0x6d, 0x13, 0x65, 0x78, 0xb5 } /* mac */
    }, {
      0, /* key_size_index */
      2, /* key_area */
      { 0x80, 0x7b, 0xc4, 0xea, 0x68, 0x4e, 0xed, 0xcf,
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        0x16, 0x1c, 0xda, 0x9f, 0x30, 0xe9, 0x79, 0x53 } /* mac */
    }, {
      0, /* key_size_index */
      3, /* key_area */
      { 0x40, 0xd9, 0x30, 0xf9, 0xa0, 0x53, 0x34, 0xd9,
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        0x1c, 0x7e, 0x27, 0x80, 0xed, 0x87, 0xd9, 0x3d } /* mac */
    }, {
      0, /* key_size_index */
      4, /* key_area */
      { 0xf8, 0xeb, 0x31, 0xb3, 0x1e, 0x37, 0x4e, 0x96,
        0x00, 0x30, 0xcd, 0x1c, 0xad, 0xb0, 0xef, 0x0c }, /* mdata */
      16, /* mdata_len */
      { 0x11, 0x0b, 0x18, 0xdb, 0xe0, 0x97, 0x56, 0x39,
        0xf7, 0x1d, 0x87, 0x7d, 0x6d, 0x07, 0x27, 0x55 } /* mac */
    }, {
      0, /* key_size_index */
      5, /* key_area */
      { 0xd3, 0xf8, 0x9b, 0x71, 0xe0, 0x33, 0x07, 0x0f,
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        0xde, 0x6c, 0xf6, 0xa0, 0xcd, 0x2d, 0x51, 0x8e } /* mac */
    }, {
      0, /* key_size_index */
      6, /* key_area */
      { 0xc6, 0x5b, 0x94, 0xb1, 0xf2, 0x91, 0xfa, 0x9f,
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        0xd8, 0xd6, 0x43, 0x6c, 0xe5, 0x75, 0x03, 0xb9 } /* mac */
    }, {
      0, /* key_size_index */
      7, /* key_area */
      { 0x22, 0xcd, 0xc3, 0x30, 0x6f, 0xcd, 0x4d, 0x31,
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        0xd5, 0x23, 0xf9, 0x7c, 0x0e, 0xdb, 0x18, 0xb0 } /* mac */
    }, {
      1, /* key_size_index */
      0, /* key_area */
      { 0xc5, 0x1f, 0xc2, 0x76, 0x77, 0x4d, 0xad, 0x94,
        0xbc, 0xdc, 0x1d, 0x28, 0x91, 0xec, 0x86, 0x68 }, /* mdata */
      16, /* mdata_len */
      { 0x40, 0xd1, 0x7f, 0x9a, 0x6f, 0x5b, 0xc6, 0xaf,
        0x34, 0x1e, 0x6a, 0xc5, 0xe4, 0x9e, 0x71, 0xad } /* mac */
    }, {
      1, /* key_size_index */
      2, /* key_area */
      { 0xbe, 0x8a, 0xbf, 0x00, 0x90, 0x13, 0x63, 0x98,
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        0x94, 0xeb, 0x37, 0x01, 0xca, 0x6b, 0xd5, 0x7b } /* mac */
    }, {
      1, /* key_size_index */
      4, /* key_area */
      { 0x39, 0xa9, 0xb4, 0x2d, 0xe1, 0x9e, 0x51, 0x2a,
        0xb7, 0xf3, 0x04, 0x35, 0x64, 0xc3, 0x51, 0x5a }, /* mdata */
      16, /* mdata_len */
      { 0xa8, 0xd9, 0x3d, 0x9e, 0x1c, 0x14, 0xe4, 0x1e,
        0xa3, 0xf0, 0xaa, 0x50, 0xa4, 0xa3, 0x26, 0x09 } /* mac */
    }, {
      1, /* key_size_index */
      6, /* key_area */
      { 0x69, 0x28, 0x29, 0x9c, 0x52, 0xb4, 0xf0, 0x47,
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        0x54, 0xe2, 0x7f, 0x1c, 0x76, 0x20, 0xa0, 0x07 } /* mac */
    }, {
      2, /* key_size_index */
      0, /* key_area */
      { 0x62, 0x82, 0xb8, 0xc0, 0x5c, 0x5c, 0x15, 0x30,
        0xb9, 0x7d, 0x48, 0x16, 0xca, 0x43, 0x47, 0x62 }, /* mdata */
      16, /* mdata_len */
      { 0xa1, 0x07, 0x61, 0x82, 0xc1, 0xf4, 0x33, 0xc3,
        0xda, 0xfb, 0xe1, 0x1d, 0x3e, 0x71, 0xdd, 0x8a } /* mac */
    }, {
      2, /* key_size_index */
      2, /* key_area */
      { 0x0c, 0x63, 0xd4, 0x13, 0xd3, 0x86, 0x45, 0x70,
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        0xe6, 0x72, 0xb8, 0x37, 0x45, 0xfa, 0xdc, 0x0f } /* mac */
    }, {
      2, /* key_size_index */
      4, /* key_area */
      { 0xd5, 0x1d, 0x19, 0xde, 0xd5, 0xca, 0x4a, 0xe1,
        0x4b, 0x2b, 0x20, 0xb0, 0x27, 0xff, 0xb0, 0x20 }, /* mdata */
      16, /* mdata_len */
      { 0xb0, 0x52, 0xa1, 0xdf, 0xe6, 0xa4, 0x8e, 0x63,
        0x43, 0x23, 0xdc, 0xaa, 0x85, 0xfa, 0xda, 0x3c } /* mac */
    }, {
      2, /* key_size_index */
      6, /* key_area */
      { 0x5b, 0x97, 0xa9, 0xd4, 0x23, 0xf4, 0xb9, 0x74,
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        0x88, 0x75, 0xa1, 0x76, 0xcc, 0x85, 0x46, 0xf9 } /* mac */
    }
  };
  static uint8_t mdata[MDATA_MAX_LEN];
  static uint8_t mac[CBC_MAC_MAC_LEN];
  static int i;
  static uint8_t key_size_index = -1, ret;
  static rtimer_clock_t time, time2, total_time;

  PROCESS_BEGIN();

  puts("-----------------------------------------\n"
       "Initializing cryptoprocessor...");
  crypto_init();

  for(i = 0; i < sizeof(vectors) / sizeof(vectors[0]); i++) {
    if(key_size_index != vectors[i].key_size_index) {
      key_size_index = vectors[i].key_size_index;
      printf("-----------------------------------------\n"
             "Filling %d-bit key store...\n", 128 + (key_size_index << 6));
      time = RTIMER_NOW();
      ret = aes_load_keys(keys[key_size_index].keys,
              keys[key_size_index].key_size, keys[key_size_index].count, 0);
      time = RTIMER_NOW() - time;
      printf("aes_load_keys(): %s, %lu us\n", str_res[ret],
             (uint32_t)((uint64_t)time * 1000000 / RTIMER_SECOND));
      PROCESS_PAUSE();
      if(ret != CRYPTO_SUCCESS) {
        break;
      }
    }

    printf("-----------------------------------------\n"
           "Test vector #%d:\n"
           "key_area=%d mdata_len=%d\n",
           i, vectors[i].key_area, vectors[i].mdata_len);

    /* mdata has to be in SRAM. */
    rom_util_memcpy(mdata, vectors[i].mdata, vectors[i].mdata_len);

    time = RTIMER_NOW();
    ret = cbc_mac_auth_start(vectors[i].key_area, mdata, vectors[i].mdata_len,
                             &cbc_mac_test_process);
    time2 = RTIMER_NOW();
    time = time2 - time;
    total_time = time;
    if(ret == CRYPTO_SUCCESS) {
      PROCESS_WAIT_EVENT_UNTIL(cbc_mac_auth_check_status());
      time2 = RTIMER_NOW() - time2;
      total_time += time2;
    }
    printf("cbc_mac_auth_start(): %s, %lu us\n", str_res[ret],
           (uint32_t)((uint64_t)time * 1000000 / RTIMER_SECOND));
    if(ret != CRYPTO_SUCCESS) {
      PROCESS_PAUSE();
      continue;
    }
    printf("cbc_mac_auth_check_status() wait: %lu us\n",
           (uint32_t)((uint64_t)time2 * 1000000 / RTIMER_SECOND));

    time = RTIMER_NOW();
    ret = cbc_mac_auth_get_result(vectors[i].mac, mac);
    time = RTIMER_NOW() - time;
    total_time += time;
    printf("cbc_mac_auth_get_result(): %s, %lu us\n", str_res[ret],
           (uint32_t)((uint64_t)time * 1000000 / RTIMER_SECOND));
    PROCESS_PAUSE();
    if(ret != CRYPTO_SUCCESS) {
      continue;
    }

    if(rom_util_memcmp(mac, vectors[i].mac, CBC_MAC_MAC_LEN)) {
      puts("MAC does not match expected one");
    } else {
      puts("MAC OK");
    }

    printf("Total duration: %lu us\n",
           (uint32_t)((uint64_t)total_time * 1000000 / RTIMER_SECOND));
  }

  puts("-----------------------------------------\n"
       "Disabling cryptoprocessor...");
  crypto_disable();

  puts("Done!");

  PROCESS_END();
}
/*---------------------------------------------------------------------------*/
/**
 * @}
 * @}
 */
