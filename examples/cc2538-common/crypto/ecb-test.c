/*
 * Copyright (c) 2015, Benoît Thébaudeau <benoit.thebaudeau.dev@gmail.com>
 * All rights reserved.
 *
 * Redistribution and use in source and binary forms, with or without
 * modification, are permitted provided that the following conditions
 * are met:
 * 1. Redistributions of source code must retain the above copyright
 *    notice, this list of conditions and the following disclaimer.
 * 2. Redistributions in binary form must reproduce the above copyright
 *    notice, this list of conditions and the following disclaimer in the
 *    documentation and/or other materials provided with the distribution.
 *
 * 3. Neither the name of the copyright holder nor the names of its
 *    contributors may be used to endorse or promote products derived
 *    from this software without specific prior written permission.
 *
 * THIS SOFTWARE IS PROVIDED BY THE COPYRIGHT HOLDERS AND CONTRIBUTORS
 * ``AS IS'' AND ANY EXPRESS OR IMPLIED WARRANTIES, INCLUDING, BUT NOT
 * LIMITED TO, THE IMPLIED WARRANTIES OF MERCHANTABILITY AND FITNESS
 * FOR A PARTICULAR PURPOSE ARE DISCLAIMED.  IN NO EVENT SHALL THE
 * COPYRIGHT HOLDER OR CONTRIBUTORS BE LIABLE FOR ANY DIRECT, INDIRECT,
 * INCIDENTAL, SPECIAL, EXEMPLARY, OR CONSEQUENTIAL DAMAGES
 * (INCLUDING, BUT NOT LIMITED TO, PROCUREMENT OF SUBSTITUTE GOODS OR
 * SERVICES; LOSS OF USE, DATA, OR PROFITS; OR BUSINESS INTERRUPTION)
 * HOWEVER CAUSED AND ON ANY THEORY OF LIABILITY, WHETHER IN CONTRACT,
 * STRICT LIABILITY, OR TORT (INCLUDING NEGLIGENCE OR OTHERWISE)
 * ARISING IN ANY WAY OUT OF THE USE OF THIS SOFTWARE, EVEN IF ADVISED
 * OF THE POSSIBILITY OF SUCH DAMAGE.
 */
/**
 * \addtogroup cc2538-examples
 * @{
 *
 * \defgroup cc2538-ecb-test cc2538 AES-ECB Test Project
 *
 *   AES-ECB access example for CC2538-based platforms
 *
 *   This example shows how AES-ECB should be used. The example also verifies
 *   the AES-ECB functionality.
 *
 * @{
 *
 * \file
 *     Example demonstrating AES-ECB
 */
#include "contiki.h"
#include "sys/rtimer.h"
#include "dev/rom-util.h"
#include "dev/ecb.h"

#include <stdbool.h>
#include <stdio.h>
#include <stdint.h>
/*---------------------------------------------------------------------------*/
#define MDATA_MAX_LEN   160
/*---------------------------------------------------------------------------*/
PROCESS(ecb_test_process, "ecb test process");
AUTOSTART_PROCESSES(&ecb_test_process);
/*---------------------------------------------------------------------------*/
PROCESS_THREAD(ecb_test_process, ev, data)
{
  static const char *const str_res[] = {
    "success",
    "invalid param",
    "NULL error",
    "resource in use",
    "DMA bus error",
    "keystore read error",
    "keystore write error",
    "authentication failed"
  };
  static const uint8_t keys128[][128 / 8] = {
    { 0xed, 0xfd, 0xb2, 0x57, 0xcb, 0x37, 0xcd, 0xf1,
      0x82, 0xc5, 0x45, 0x5b, 0x0c, 0x0e, 0xfe, 0xbb },
    { 0xef, 0x60, 0xfb, 0x14, 0x00, 0xc8, 0x39, 0x36,
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      0xa3, 0x92, 0x4c, 0xfb, 0x07, 0x89, 0x44, 0xbb }
  };
  static const uint8_t keys192[][192 / 8] = {
    { 0x61, 0x39, 0x6c, 0x53, 0x0c, 0xc1, 0x74, 0x9a,
      0x5b, 0xab, 0x6f, 0xbc, 0xf9, 0x06, 0xfe, 0x67,
      0x2d, 0x0c, 0x4a, 0xb2, 0x01, 0xaf, 0x45, 0x54 },
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    { 0x9c, 0xc2, 0x4e, 0xa1, 0xf1, 0x95, 0x9d, 0x9a,
      0x97, 0x2e, 0x71, 0x82, 0xef, 0x3b, 0x4e, 0x22,
      0xa9, 0x7a, 0x87, 0xd0, 0xda, 0x7f, 0xf6, 0x4b }
  };
  static const uint8_t keys256[][256 / 8] = {
    { 0xcc, 0x22, 0xda, 0x78, 0x7f, 0x37, 0x57, 0x11,
      0xc7, 0x63, 0x02, 0xbe, 0xf0, 0x97, 0x9d, 0x8e,
      0xdd, 0xf8, 0x42, 0x82, 0x9c, 0x2b, 0x99, 0xef,
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      0x59, 0x0b, 0x05, 0x97, 0x4e, 0x18, 0x5c, 0x5b }
  };
  static const struct {
    const void *keys;
    uint8_t key_size;
    uint8_t count;
  } keys[] = {
    { keys128, AES_KEY_STORE_SIZE_KEY_SIZE_128,
      sizeof(keys128) / sizeof(keys128[0]) },
    { keys192, AES_KEY_STORE_SIZE_KEY_SIZE_192,
      sizeof(keys192) / sizeof(keys192[0]) },
    { keys256, AES_KEY_STORE_SIZE_KEY_SIZE_256,
      sizeof(keys256) / sizeof(keys256[0]) }
  };
  static const struct {
    bool encrypt;
    uint8_t key_size_index;
    uint8_t key_area;
    uint8_t mdata[MDATA_MAX_LEN];
    uint16_t mdata_len;
    uint8_t expected[MDATA_MAX_LEN];
  } vectors[] = {
    {
      true, /* encrypt */
      0, /* key_size_index */
      0, /* key_area */
      { 0x16, 0x95, 0xfe, 0x47, 0x54, 0x21, 0xca, 0xce,
        0x35, 0x57, 0xda, 0xca, 0x01, 0xf4, 0x45, 0xff }, /* mdata */
      16, /* mdata_len */
      { 0x78, 0x88, 0xbe, 0xae, 0x6e, 0x7a, 0x42, 0x63,
        0x32, 0xa7, 0xea, 0xa2, 0xf8, 0x08, 0xe6, 0x37 } /* expected */
    }, {
      true, /* encrypt */
      0, /* key_size_index */
      1, /* key_area */
      { 0x59, 0x35, 0x59, 0x31, 0x8c, 0xc6, 0x6b, 0xf6,
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        0x6e, 0xfb, 0xe4, 0xec, 0xd4, 0x6a, 0x30, 0x58 } /* expected */
    }, {
      true, /* encrypt */
      0, /* key_size_index */
      2, /* key_area */
      { 0x37, 0xa1, 0x20, 0x5e, 0xa9, 0x29, 0x35, 0x5d,
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        0x9f, 0x89, 0xd0, 0x49, 0x0b, 0x6a, 0xef, 0xc1 } /* expected */
    }, {
      true, /* encrypt */
      0, /* key_size_index */
      3, /* key_area */
      { 0x45, 0x1f, 0x45, 0x66, 0x3b, 0x44, 0xfd, 0x00,
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        0x0f, 0x20, 0xb3, 0xb7, 0x7b, 0x93, 0x8b, 0x1a } /* expected */
    }, {
      false, /* encrypt */
      0, /* key_size_index */
      4, /* key_area */
      { 0x06, 0x5b, 0xd5, 0xa9, 0x54, 0x0d, 0x22, 0xd5,
        0xd7, 0xb0, 0xf7, 0x5d, 0x66, 0xcb, 0x8b, 0x30 }, /* mdata */
      16, /* mdata_len */
      { 0x46, 0xf2, 0xc9, 0x89, 0x32, 0x34, 0x9c, 0x33,
        0x8e, 0x9d, 0x67, 0xf7, 0x44, 0xa1, 0xc9, 0x88 } /* expected */
    }, {
      false, /* encrypt */
      0, /* key_size_index */
      5, /* key_area */
      { 0x6c, 0x53, 0x48, 0x9f, 0x6a, 0x4b, 0xd0, 0xf7,
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        0x8b, 0x32, 0x09, 0x1d, 0xf5, 0x51, 0x6f, 0x57 } /* expected */
    }, {
      false, /* encrypt */
      0, /* key_size_index */
      6, /* key_area */
      { 0x4d, 0x6f, 0x97, 0x29, 0x46, 0xa2, 0xe4, 0xca,
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        0xf5, 0x29, 0x74, 0xb6, 0x18, 0x2c, 0xb1, 0x06 } /* expected */
    }, {
      false, /* encrypt */
      0, /* key_size_index */
      7, /* key_area */
      { 0x93, 0x1b, 0x2f, 0x5f, 0x3a, 0x58, 0x20, 0xd5,
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        0xc7, 0x25, 0xda, 0xed, 0x54, 0x0e, 0xd9, 0xe7 } /* expected */
    }, {
      true, /* encrypt */
      1, /* key_size_index */
      0, /* key_area */
      { 0x60, 0xbc, 0xdb, 0x94, 0x16, 0xba, 0xc0, 0x8d,
        0x7f, 0xd0, 0xd7, 0x80, 0x35, 0x37, 0x40, 0xa5 }, /* mdata */
      16, /* mdata_len */
      { 0x24, 0xf4, 0x0c, 0x4e, 0xec, 0xd9, 0xc4, 0x98,
        0x25, 0x00, 0x0f, 0xcb, 0x49, 0x72, 0x64, 0x7a } /* expected */
    }, {
      true, /* encrypt */
      1, /* key_size_index */
      2, /* key_area */
      { 0x7c, 0x72, 0x7b, 0xd3, 0xe7, 0x04, 0x8e, 0x7a,
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        0x68, 0xc5, 0x8f, 0x23, 0xf1, 0xf9, 0x4c, 0xfd } /* expected */
    }, {
      false, /* encrypt */
      1, /* key_size_index */
      4, /* key_area */
      { 0x21, 0xc8, 0x22, 0x9a, 0x4d, 0xce, 0xaf, 0x53,
        0x3f, 0xe4, 0xe9, 0x6e, 0xce, 0xd4, 0x82, 0xa6 }, /* mdata */
      16, /* mdata_len */
      { 0x49, 0xaa, 0xbe, 0x67, 0xda, 0x53, 0x22, 0xb6,
        0xe1, 0x1d, 0x63, 0xb7, 0x8b, 0x5a, 0x0e, 0x15 } /* expected */
    }, {
      false, /* encrypt */
      1, /* key_size_index */
      6, /* key_area */
      { 0x95, 0x2f, 0x45, 0x46, 0xa8, 0xbf, 0x71, 0x66,
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        0x80, 0x47, 0x9b, 0x4f, 0x4b, 0x28, 0xb5, 0xfe } /* expected */
    }, {
      true, /* encrypt */
      2, /* key_size_index */
      0, /* key_area */
      { 0xcc, 0xc6, 0x2c, 0x6b, 0x0a, 0x09, 0xa6, 0x71,
        0xd6, 0x44, 0x56, 0x81, 0x8d, 0xb2, 0x9a, 0x4d }, /* mdata */
      16, /* mdata_len */
      { 0xdf, 0x86, 0x34, 0xca, 0x02, 0xb1, 0x3a, 0x12,
        0x5b, 0x78, 0x6e, 0x1d, 0xce, 0x90, 0x65, 0x8b } /* expected */
    }, {
      true, /* encrypt */
      2, /* key_size_index */
      2, /* key_area */
      { 0xc9, 0x1b, 0x8a, 0x7b, 0x9c, 0x51, 0x17, 0x84,
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        0x0a, 0xd1, 0xf0, 0x9c, 0xfe, 0x9c, 0xee, 0x4a } /* expected */
    }, {
      false, /* encrypt */
      2, /* key_size_index */
      4, /* key_area */
      { 0x41, 0x54, 0xc0, 0xbe, 0x71, 0x07, 0x29, 0x45,
        0xd8, 0x15, 0x6f, 0x5f, 0x04, 0x6d, 0x19, 0x8d }, /* mdata */
      16, /* mdata_len */
      { 0x8b, 0x2b, 0x1b, 0x22, 0xf7, 0x33, 0xac, 0x09,
        0xd1, 0x19, 0x6d, 0x6b, 0xe6, 0xa8, 0x7a, 0x72 } /* expected */
    }, {
      false, /* encrypt */
      2, /* key_size_index */
      6, /* key_area */
      { 0x2c, 0x48, 0x7f, 0xa9, 0x6f, 0x40, 0x90, 0xc5,
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        0x4a, 0x03, 0x29, 0x7e, 0x1c, 0xcc, 0x95, 0x39 } /* expected */
    }
  };
  static uint8_t mdata[MDATA_MAX_LEN];
  static int i;
  static uint8_t key_size_index = -1, ret;
  static int8_t res;
  static rtimer_clock_t time, time2, total_time;

  PROCESS_BEGIN();

  puts("-----------------------------------------\n"
       "Initializing cryptoprocessor...");
  crypto_init();

  for(i = 0; i < sizeof(vectors) / sizeof(vectors[0]); i++) {
    if(key_size_index != vectors[i].key_size_index) {
      key_size_index = vectors[i].key_size_index;
      printf("-----------------------------------------\n"
             "Filling %d-bit key store...\n", 128 + (key_size_index << 6));
      time = RTIMER_NOW();
      ret = aes_load_keys(keys[key_size_index].keys,
              keys[key_size_index].key_size, keys[key_size_index].count, 0);
      time = RTIMER_NOW() - time;
      printf("aes_load_keys(): %s, %lu us\n", str_res[ret],
             (uint32_t)((uint64_t)time * 1000000 / RTIMER_SECOND));
      PROCESS_PAUSE();
      if(ret != CRYPTO_SUCCESS) {
        break;
      }
    }

    printf("-----------------------------------------\n"
           "Test vector #%d: %s\n"
           "key_area=%d mdata_len=%d\n",
           i, vectors[i].encrypt ? "encrypt" : "decrypt",
           vectors[i].key_area, vectors[i].mdata_len);

    /* mdata has to be in SRAM. */
    rom_util_memcpy(mdata, vectors[i].mdata, vectors[i].mdata_len);

    time = RTIMER_NOW();
    ret = ecb_crypt_start(vectors[i].encrypt, vectors[i].key_area, mdata, mdata,
                          vectors[i].mdata_len, &ecb_test_process);
    time2 = RTIMER_NOW();
    time = time2 - time;
    total_time = time;
    if(ret == CRYPTO_SUCCESS) {
      PROCESS_WAIT_EVENT_UNTIL((res = ecb_crypt_check_status()) !=
                               CRYPTO_PENDING);
      time2 = RTIMER_NOW() - time2;
      total_time += time2;
    }
    printf("ecb_crypt_start(): %s, %lu us\n", str_res[ret],
           (uint32_t)((uint64_t)time * 1000000 / RTIMER_SECOND));
    if(ret != CRYPTO_SUCCESS) {
      PROCESS_PAUSE();
      continue;
    }
    printf("ecb_crypt_check_status() wait: %s, %lu us\n", str_res[res],
           (uint32_t)((uint64_t)time2 * 1000000 / RTIMER_SECOND));
    PROCESS_PAUSE();
    if(res != CRYPTO_SUCCESS) {
      continue;
    }

    if(rom_util_memcmp(mdata, vectors[i].expected, vectors[i].mdata_len)) {
      puts("Output message does not match expected one");
    } else {
      puts("Output message OK");
    }

    printf("Total duration: %lu us\n",
           (uint32_t)((uint64_t)total_time * 1000000 / RTIMER_SECOND));
  }

  puts("-----------------------------------------\n"
       "Disabling cryptoprocessor...");
  crypto_disable();

  puts("Done!");

  PROCESS_END();
}
/*---------------------------------------------------------------------------*/
/**
 * @}
 * @}
 */
