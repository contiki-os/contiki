/*
 * Copyright (c) 2015, Benoît Thébaudeau <benoit.thebaudeau.dev@gmail.com>
 * All rights reserved.
 *
 * Redistribution and use in source and binary forms, with or without
 * modification, are permitted provided that the following conditions
 * are met:
 * 1. Redistributions of source code must retain the above copyright
 *    notice, this list of conditions and the following disclaimer.
 * 2. Redistributions in binary form must reproduce the above copyright
 *    notice, this list of conditions and the following disclaimer in the
 *    documentation and/or other materials provided with the distribution.
 *
 * 3. Neither the name of the copyright holder nor the names of its
 *    contributors may be used to endorse or promote products derived
 *    from this software without specific prior written permission.
 *
 * THIS SOFTWARE IS PROVIDED BY THE COPYRIGHT HOLDERS AND CONTRIBUTORS
 * ``AS IS'' AND ANY EXPRESS OR IMPLIED WARRANTIES, INCLUDING, BUT NOT
 * LIMITED TO, THE IMPLIED WARRANTIES OF MERCHANTABILITY AND FITNESS
 * FOR A PARTICULAR PURPOSE ARE DISCLAIMED.  IN NO EVENT SHALL THE
 * COPYRIGHT HOLDER OR CONTRIBUTORS BE LIABLE FOR ANY DIRECT, INDIRECT,
 * INCIDENTAL, SPECIAL, EXEMPLARY, OR CONSEQUENTIAL DAMAGES
 * (INCLUDING, BUT NOT LIMITED TO, PROCUREMENT OF SUBSTITUTE GOODS OR
 * SERVICES; LOSS OF USE, DATA, OR PROFITS; OR BUSINESS INTERRUPTION)
 * HOWEVER CAUSED AND ON ANY THEORY OF LIABILITY, WHETHER IN CONTRACT,
 * STRICT LIABILITY, OR TORT (INCLUDING NEGLIGENCE OR OTHERWISE)
 * ARISING IN ANY WAY OUT OF THE USE OF THIS SOFTWARE, EVEN IF ADVISED
 * OF THE POSSIBILITY OF SUCH DAMAGE.
 */
/**
 * \addtogroup cc2538-examples
 * @{
 *
 * \defgroup cc2538-cbc-test cc2538 AES-CBC Test Project
 *
 *   AES-CBC access example for CC2538-based platforms
 *
 *   This example shows how AES-CBC should be used. The example also verifies
 *   the AES-CBC functionality.
 *
 * @{
 *
 * \file
 *     Example demonstrating AES-CBC
 */
#include "contiki.h"
#include "sys/rtimer.h"
#include "dev/rom-util.h"
#include "dev/cbc.h"

#include <stdbool.h>
#include <stdio.h>
#include <stdint.h>
/*---------------------------------------------------------------------------*/
#define MDATA_MAX_LEN   160
/*---------------------------------------------------------------------------*/
PROCESS(cbc_test_process, "cbc test process");
AUTOSTART_PROCESSES(&cbc_test_process);
/*---------------------------------------------------------------------------*/
PROCESS_THREAD(cbc_test_process, ev, data)
{
  static const char *const str_res[] = {
    "success",
    "invalid param",
    "NULL error",
    "resource in use",
    "DMA bus error",
    "keystore read error",
    "keystore write error",
    "authentication failed"
  };
  static const uint8_t keys128[][128 / 8] = {
    { 0x1f, 0x8e, 0x49, 0x73, 0x95, 0x3f, 0x3f, 0xb0,
      0xbd, 0x6b, 0x16, 0x66, 0x2e, 0x9a, 0x3c, 0x17 },
    { 0xb7, 0xf3, 0xc9, 0x57, 0x6e, 0x12, 0xdd, 0x0d,
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      0x25, 0xbb, 0xe7, 0x87, 0x70, 0xca, 0x2f, 0x99 }
  };
  static const uint8_t keys192[][192 / 8] = {
    { 0xba, 0x75, 0xf4, 0xd1, 0xd9, 0xd7, 0xcf, 0x7f,
      0x55, 0x14, 0x45, 0xd5, 0x6c, 0xc1, 0xa8, 0xab,
      0x2a, 0x07, 0x8e, 0x15, 0xe0, 0x49, 0xdc, 0x2c },
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    { 0x50, 0x9b, 0xaf, 0x46, 0xfb, 0x9d, 0xe3, 0x42,
      0x81, 0xda, 0xfc, 0xc3, 0xdb, 0x79, 0x59, 0x3b,
      0xff, 0xa8, 0x42, 0x69, 0x04, 0x30, 0x26, 0x88 }
  };
  static const uint8_t keys256[][256 / 8] = {
    { 0x6e, 0xd7, 0x6d, 0x2d, 0x97, 0xc6, 0x9f, 0xd1,
      0x33, 0x95, 0x89, 0x52, 0x39, 0x31, 0xf2, 0xa6,
      0xcf, 0xf5, 0x54, 0xb1, 0x5f, 0x73, 0x8f, 0x21,
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      0x84, 0x19, 0x0e, 0x44, 0xd1, 0x4c, 0x69, 0x96 }
  };
  static const struct {
    const void *keys;
    uint8_t key_size;
    uint8_t count;
  } keys[] = {
    { keys128, AES_KEY_STORE_SIZE_KEY_SIZE_128,
      sizeof(keys128) / sizeof(keys128[0]) },
    { keys192, AES_KEY_STORE_SIZE_KEY_SIZE_192,
      sizeof(keys192) / sizeof(keys192[0]) },
    { keys256, AES_KEY_STORE_SIZE_KEY_SIZE_256,
      sizeof(keys256) / sizeof(keys256[0]) }
  };
  static const struct {
    bool encrypt;
    uint8_t key_size_index;
    uint8_t key_area;
    uint8_t iv[CBC_IV_LEN];
    uint8_t mdata[MDATA_MAX_LEN];
    uint16_t mdata_len;
    uint8_t expected[MDATA_MAX_LEN];
  } vectors[] = {
    {
      true, /* encrypt */
      0, /* key_size_index */
      0, /* key_area */
      { 0x2f, 0xe2, 0xb3, 0x33, 0xce, 0xda, 0x8f, 0x98,
        0xf4, 0xa9, 0x9b, 0x40, 0xd2, 0xcd, 0x34, 0xa8 }, /* iv */
      { 0x45, 0xcf, 0x12, 0x96, 0x4f, 0xc8, 0x24, 0xab,
        0x76, 0x61, 0x6a, 0xe2, 0xf4, 0xbf, 0x08, 0x22 }, /* mdata */
      16, /* mdata_len */
      { 0x0f, 0x61, 0xc4, 0xd4, 0x4c, 0x51, 0x47, 0xc0,
        0x3c, 0x19, 0x5a, 0xd7, 0xe2, 0xcc, 0x12, 0xb2 } /* expected */
    }, {
      true, /* encrypt */
      0, /* key_size_index */
      1, /* key_area */
      { 0xc8, 0x0f, 0x09, 0x5d, 0x8b, 0xb1, 0xa0, 0x60,
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        0xae, 0x73, 0x8e, 0xbe, 0xae, 0x84, 0xa4, 0x67 } /* expected */
    }, {
      true, /* encrypt */
      0, /* key_size_index */
      2, /* key_area */
      { 0xf7, 0x24, 0x55, 0x8d, 0xb3, 0x43, 0x3a, 0x52,
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        0xa4, 0x84, 0x9e, 0xec, 0x37, 0xce, 0x72, 0x1a } /* expected */
    }, {
      true, /* encrypt */
      0, /* key_size_index */
      3, /* key_area */
      { 0x1d, 0xbb, 0xeb, 0x2f, 0x19, 0xab, 0xb4, 0x48,
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        0x0f, 0x11, 0x74, 0x35, 0xa0, 0x35, 0x5b, 0x2b } /* expected */
    }, {
      false, /* encrypt */
      0, /* key_size_index */
      4, /* key_area */
      { 0xbd, 0x41, 0x72, 0x93, 0x40, 0x78, 0xc2, 0x01,
        0x1c, 0xb1, 0xf3, 0x1c, 0xff, 0xaf, 0x48, 0x6e }, /* iv */
      { 0xf8, 0xeb, 0x31, 0xb3, 0x1e, 0x37, 0x4e, 0x96,
        0x00, 0x30, 0xcd, 0x1c, 0xad, 0xb0, 0xef, 0x0c }, /* mdata */
      16, /* mdata_len */
      { 0x94, 0x0b, 0xc7, 0x6d, 0x61, 0xe2, 0xc4, 0x9d,
        0xdd, 0xd5, 0xdf, 0x7f, 0x37, 0xfc, 0xf1, 0x05 } /* expected */
    }, {
      false, /* encrypt */
      0, /* key_size_index */
      5, /* key_area */
      { 0x0b, 0x1e, 0x74, 0xf4, 0x5c, 0x17, 0xff, 0x30,
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        0x4e, 0xfe, 0xe2, 0x91, 0xa1, 0xf1, 0xaf, 0x60 } /* expected */
    }, {
      false, /* encrypt */
      0, /* key_size_index */
      6, /* key_area */
      { 0x68, 0xb9, 0x14, 0x0f, 0x30, 0x04, 0x90, 0xc5,
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        0x0a, 0x39, 0x42, 0xec, 0x18, 0x2d, 0xcb, 0xd7 } /* expected */
    }, {
      false, /* encrypt */
      0, /* key_size_index */
      7, /* key_area */
      { 0xd4, 0xb4, 0xea, 0xb9, 0x2a, 0xa9, 0x63, 0x7e,
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        0x5c, 0x01, 0x63, 0x00, 0xa3, 0x90, 0xbf, 0xa7 } /* expected */
    }, {
      true, /* encrypt */
      1, /* key_size_index */
      0, /* key_area */
      { 0x53, 0x1c, 0xe7, 0x81, 0x76, 0x40, 0x16, 0x66,
        0xaa, 0x30, 0xdb, 0x94, 0xec, 0x4a, 0x30, 0xeb }, /* iv */
      { 0xc5, 0x1f, 0xc2, 0x76, 0x77, 0x4d, 0xad, 0x94,
        0xbc, 0xdc, 0x1d, 0x28, 0x91, 0xec, 0x86, 0x68 }, /* mdata */
      16, /* mdata_len */
      { 0x70, 0xdd, 0x95, 0xa1, 0x4e, 0xe9, 0x75, 0xe2,
        0x39, 0xdf, 0x36, 0xff, 0x4a, 0xee, 0x1d, 0x5d } /* expected */
    }, {
      true, /* encrypt */
      1, /* key_size_index */
      2, /* key_area */
      { 0x24, 0x40, 0x80, 0x38, 0x16, 0x1a, 0x2c, 0xca,
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        0xac, 0x87, 0xf3, 0x9f, 0xf8, 0xc3, 0x1b, 0x84 } /* expected */
    }, {
      false, /* encrypt */
      1, /* key_size_index */
      4, /* key_area */
      { 0x32, 0x40, 0x15, 0x87, 0x8c, 0xdc, 0x82, 0xbf,
        0xae, 0x59, 0xa2, 0xdc, 0x1f, 0xf3, 0x4e, 0xa6 }, /* iv */
      { 0x39, 0xa9, 0xb4, 0x2d, 0xe1, 0x9e, 0x51, 0x2a,
        0xb7, 0xf3, 0x04, 0x35, 0x64, 0xc3, 0x51, 0x5a }, /* mdata */
      16, /* mdata_len */
      { 0xaa, 0x41, 0x17, 0x9d, 0x88, 0x0e, 0x6f, 0xe3,
        0xb1, 0x48, 0x18, 0xd6, 0xe4, 0xa6, 0x2e, 0xb5 } /* expected */
    }, {
      false, /* encrypt */
      1, /* key_size_index */
      6, /* key_area */
      { 0xd6, 0xd8, 0x6e, 0x0c, 0x82, 0xdd, 0x87, 0x88,
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        0xeb, 0xa9, 0x33, 0x2a, 0x76, 0x3d, 0x9c, 0x94 } /* expected */
    }, {
      true, /* encrypt */
      2, /* key_size_index */
      0, /* key_area */
      { 0x85, 0x1e, 0x87, 0x64, 0x77, 0x6e, 0x67, 0x96,
        0xaa, 0xb7, 0x22, 0xdb, 0xb6, 0x44, 0xac, 0xe8 }, /* iv */
      { 0x62, 0x82, 0xb8, 0xc0, 0x5c, 0x5c, 0x15, 0x30,
        0xb9, 0x7d, 0x48, 0x16, 0xca, 0x43, 0x47, 0x62 }, /* mdata */
      16, /* mdata_len */
      { 0x6a, 0xcc, 0x04, 0x14, 0x2e, 0x10, 0x0a, 0x65,
        0xf5, 0x1b, 0x97, 0xad, 0xf5, 0x17, 0x2c, 0x41 } /* expected */
    }, {
      true, /* encrypt */
      2, /* key_size_index */
      2, /* key_area */
      { 0xd6, 0xd5, 0x81, 0xb8, 0xcf, 0x04, 0xeb, 0xd3,
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        0x4d, 0x37, 0xfb, 0xc9, 0x30, 0x44, 0x48, 0xcd } /* expected */
    }, {
      false, /* encrypt */
      2, /* key_size_index */
      4, /* key_area */
      { 0xdd, 0xbb, 0xb0, 0x17, 0x3f, 0x1e, 0x2d, 0xeb,
        0x23, 0x94, 0xa6, 0x2a, 0xa2, 0xa0, 0x24, 0x0e }, /* iv */
      { 0xd5, 0x1d, 0x19, 0xde, 0xd5, 0xca, 0x4a, 0xe1,
        0x4b, 0x2b, 0x20, 0xb0, 0x27, 0xff, 0xb0, 0x20 }, /* mdata */
      16, /* mdata_len */
      { 0x07, 0x27, 0x0d, 0x0e, 0x63, 0xaa, 0x36, 0xda,
        0xed, 0x8c, 0x6a, 0xde, 0x13, 0xac, 0x1a, 0xf1 } /* expected */
    }, {
      false, /* encrypt */
      2, /* key_size_index */
      6, /* key_area */
      { 0xe4, 0x96, 0x51, 0x98, 0x8e, 0xbb, 0xb7, 0x2e,
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        0x5c, 0xfc, 0x12, 0xf7, 0xf5, 0x4f, 0x69, 0x9f } /* expected */
    }
  };
  static uint8_t mdata[MDATA_MAX_LEN];
  static int i;
  static uint8_t key_size_index = -1, ret;
  static int8_t res;
  static rtimer_clock_t time, time2, total_time;

  PROCESS_BEGIN();

  puts("-----------------------------------------\n"
       "Initializing cryptoprocessor...");
  crypto_init();

  for(i = 0; i < sizeof(vectors) / sizeof(vectors[0]); i++) {
    if(key_size_index != vectors[i].key_size_index) {
      key_size_index = vectors[i].key_size_index;
      printf("-----------------------------------------\n"
             "Filling %d-bit key store...\n", 128 + (key_size_index << 6));
      time = RTIMER_NOW();
      ret = aes_load_keys(keys[key_size_index].keys,
              keys[key_size_index].key_size, keys[key_size_index].count, 0);
      time = RTIMER_NOW() - time;
      printf("aes_load_keys(): %s, %lu us\n", str_res[ret],
             (uint32_t)((uint64_t)time * 1000000 / RTIMER_SECOND));
      PROCESS_PAUSE();
      if(ret != CRYPTO_SUCCESS) {
        break;
      }
    }

    printf("-----------------------------------------\n"
           "Test vector #%d: %s\n"
           "key_area=%d mdata_len=%d\n",
           i, vectors[i].encrypt ? "encrypt" : "decrypt",
           vectors[i].key_area, vectors[i].mdata_len);

    /* mdata has to be in SRAM. */
    rom_util_memcpy(mdata, vectors[i].mdata, vectors[i].mdata_len);

    time = RTIMER_NOW();
    ret = cbc_crypt_start(vectors[i].encrypt, vectors[i].key_area,
                          vectors[i].iv, mdata, mdata, vectors[i].mdata_len,
                          &cbc_test_process);
    time2 = RTIMER_NOW();
    time = time2 - time;
    total_time = time;
    if(ret == CRYPTO_SUCCESS) {
      PROCESS_WAIT_EVENT_UNTIL((res = cbc_crypt_check_status()) !=
                               CRYPTO_PENDING);
      time2 = RTIMER_NOW() - time2;
      total_time += time2;
    }
    printf("cbc_crypt_start(): %s, %lu us\n", str_res[ret],
           (uint32_t)((uint64_t)time * 1000000 / RTIMER_SECOND));
    if(ret != CRYPTO_SUCCESS) {
      PROCESS_PAUSE();
      continue;
    }
    printf("cbc_crypt_check_status() wait: %s, %lu us\n", str_res[res],
           (uint32_t)((uint64_t)time2 * 1000000 / RTIMER_SECOND));
    PROCESS_PAUSE();
    if(res != CRYPTO_SUCCESS) {
      continue;
    }

    if(rom_util_memcmp(mdata, vectors[i].expected, vectors[i].mdata_len)) {
      puts("Output message does not match expected one");
    } else {
      puts("Output message OK");
    }

    printf("Total duration: %lu us\n",
           (uint32_t)((uint64_t)total_time * 1000000 / RTIMER_SECOND));
  }

  puts("-----------------------------------------\n"
       "Disabling cryptoprocessor...");
  crypto_disable();

  puts("Done!");

  PROCESS_END();
}
/*---------------------------------------------------------------------------*/
/**
 * @}
 * @}
 */
